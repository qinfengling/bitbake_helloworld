## conf/bblayers.conf
```bitbake
BBLAYERS ?= " \
	     /home/vagrant/tmp/bitbake_demo/bitbake_helloworld/fakelayer \
	     /home/vagrant/tmp/bitbake_demo/bitbake_helloworld/meta-skeleton \
              "
```

## fakelayer/conf/layer.conf
```bitbake
BBPATH .= ":${LAYERDIR}"
BBFILES += "${LAYERDIR}/*.bb"
BBFILE_COLLECTIONS += "fakelayer"
BBFILE_PATTERN_fakelayer := "^${LAYERDIR}/"
```
